## conf/distro/maivin.conf
```bitbake
require conf/distro/poky.conf
require conf/distro/include/arm-defaults.inc

DISTRO = "maivin"
DISTRO_NAME = "Maivin Distro"
DISTRO_FLAVOUR = ""

IMX_DEFAULT_BSP = "nxp"

TDX_BUILDNBR ?= "0"
TDX_PURPOSE ?= "Testing"

TDX_BUILD ?= "+build.${TDX_BUILDNBR}"
TDX_MATRIX_BUILD_TIME ?= "${DATETIME}"
TDX_MATRIX_BUILD_TIME[vardepsexclude] = "DATETIME"
TDX_PRERELEASE ?= ""
TDX_MAJOR ?= "0"
TDX_MINOR ?= "0"
TDX_PATCH ?= "0"
TDX_RELEASE ?= "${TDX_MAJOR}.${TDX_MINOR}.${TDX_PATCH}"

# Toradex Version number without date for U-Boot/Kernel and other Toradex
# specific software artifacts.
TDX_VERSION ?= "${TDX_RELEASE}${@'' if d.getVar('TDX_PURPOSE') == 'Release' else '-devel'}"

# Show Tezi EULA license
TEZI_SHOW_EULA_LICENSE ?= "1"
TEZI_SHOW_EULA_LICENSE:use-mainline-bsp ?= "0"
TEZI_SHOW_EULA_LICENSE:colibri-imx6:use-mainline-bsp ?= "1"
TEZI_SHOW_EULA_LICENSE:apalis-imx6:use-mainline-bsp ?= "1"

# Complete image version with date and build number
DISTRO_VERSION = "${TDX_RELEASE}${TDX_PRERELEASE}${TDX_BUILD}"

SDK_VENDOR = "-tdxsdk"
SDK_NAME_PREFIX = "${DISTRO}"
# do not use elements in SDK_VERSION which are in vardepsexclude
SDK_VERSION = "${TDX_RELEASE}"

MAINTAINER = "Au-Zone Technologies <info@au-zone.com>"

TARGET_VENDOR = "-tdx"

DISTROOVERRIDES .= ":tdx"

# create etc/build in the rootfs
INHERIT += "image-buildinfo"

# Log information on images and packages
INHERIT += "buildhistory"
BUILDHISTORY_COMMIT = "1"

IMAGE_LINGUAS ?= "en-us"

# Some Toradex recipes like linux-toradex, u-boot-toradex,
# device-tree-overlays are appending SCM hashes to PV, version
# numbers going backwards are not a problem as we don't provide
# binary feeds.
#
# This avoids some annoying errors as follows:
# | QA Issue: Package version went backwards which would break package feeds
ERROR_QA:remove = "version-going-backwards"

DISTRO_FEATURES:append = " pam systemd opengl wayland"
DISTRO_FEATURES:remove = "sysvinit 3g alsa irda pcmcia nfc ldconfig pulseaudio ptest multiarch x11"

DISTRO_FEATURES_BACKFILL_CONSIDERED = "sysvinit"
VIRTUAL-RUNTIME_init_manager = "systemd"
VIRTUAL-RUNTIME_initscripts = ""

PREFERRED_RPROVIDER_network-configuration = "networkmanager"
PREFERRED_PROVIDER_u-boot-fw-utils = "libubootenv"
PREFERRED_RPROVIDER_u-boot-fw-utils = "libubootenv"
PREFERRED_PROVIDER_virtual/dtb = "maivin-overlays"

PREFERRED_PROVIDER_opencl-headers:imxgpu      = "imx-gpu-viv"
PREFERRED_PROVIDER_opencl-clhpp:imxgpu        = "imx-gpu-viv"
PREFERRED_PROVIDER_opencl-icd-loader:imxgpu   = "imx-gpu-viv"
PREFERRED_RPROVIDER_opencl-icd-loader:imxgpu  = "libopencl-imx"
```

## conf/layer.conf
```bitbake
# We have a conf and classes directory, add to BBPATH
BBPATH .= ":${LAYERDIR}"

# We have recipes-* directories, add to BBFILES
BBFILES += "${LAYERDIR}/recipes-*/*/*.bb \
            ${LAYERDIR}/recipes-*/*/*.bbappend"

BBFILE_COLLECTIONS += "meta-maivin"
BBFILE_PATTERN_meta-maivin = "^${LAYERDIR}/"
BBFILE_PRIORITY_meta-maivin = "90"

LAYERSERIES_COMPAT_meta-maivin = "kirkstone"
```

## conf/machine/include/verdin-imx8mp.inc
```bitbake
KERNEL_DEVICETREE:append = " freescale/imx8mp-verdin-nonwifi-maivin.dtb"
KERNEL_DEVICETREE:append = " freescale/imx8mp-verdin-wifi-maivin.dtb"

MACHINE_EXTRA_RRECOMMENDS:append = " kernel-module-mdio-netlink"
MACHINE_EXTRA_RRECOMMENDS:append = " kernel-module-isp-vvcam"
MACHINE_EXTRA_RRECOMMENDS:append = " kernel-module-imx-gpu-viv"
MACHINE_EXTRA_RRECOMMENDS:append = " kernel-module-dp83tg720"
MACHINE_EXTRA_RRECOMMENDS:append = " kernel-module-uiodma"
```

## conf/machine/maivin.conf
```bitbake
#@TYPE: Machine
#@NAME: NXP i.MX 8M Plus
#@SOC: i.MX8MP
#@DESCRIPTION: Machine configuration for NXP i.MX 8M Plus Evaluation Kit with LPDDR4
#@MAINTAINER: Jun Zhu <junzhu@nxp.com>

require conf/machine/include/imx8mp-evk.inc

# The device tree name is implicit for LPDDR4, so can't use MACHINE here
KERNEL_DEVICETREE_BASENAME = "maivin"

# NXP kernel has additional DTB files for various board configuration and
# derivates. Include them here for NXP BSP only
KERNEL_DEVICETREE:append:use-nxp-bsp = " \
        freescale/maivin.dtb \
"

UBOOT_DTB_NAME = "imx8mp-evk.dtb"
UBOOT_CONFIG_BASENAME = "imx8mp_evk"
UBOOT_CONFIG[fspi] = "${UBOOT_CONFIG_BASENAME}_defconfig"

# Set DDR FIRMWARE
DDR_FIRMWARE_VERSION = "202006"
DDR_FIRMWARE_NAME = " \
        lpddr4_pmu_train_1d_dmem_${DDR_FIRMWARE_VERSION}.bin \
        lpddr4_pmu_train_1d_imem_${DDR_FIRMWARE_VERSION}.bin \
        lpddr4_pmu_train_2d_dmem_${DDR_FIRMWARE_VERSION}.bin \
        lpddr4_pmu_train_2d_imem_${DDR_FIRMWARE_VERSION}.bin \
"

IMXBOOT_TARGETS_BASENAME = "flash_evk"
```

## conf/machine/verdin-imx8mp-maivin.conf
```bitbake
KERNEL_DEVICETREE:append = " freescale/imx8mp-verdin-nonwifi-maivin.dtb"
KERNEL_DEVICETREE:append = " freescale/imx8mp-verdin-wifi-maivin.dtb"
```
