// SPDX-License-Identifier: GPL-2.0-or-later OR MIT
/*
 * Copyright 2022 Toradex
 */

/dts-v1/;

#include "imx8mp-verdin.dtsi"
#include "imx8mp-verdin-wifi.dtsi"
#include "imx8mp-verdin-maivin.dtsi"

/ {
	model = "Maivin AI Vision Starter Kit";
	compatible = "au-zone,verdin-imx8mp-wifi-maivin",
			 "toradex,verdin-imx8mp-wifi-dev",
		     "toradex,verdin-imx8mp-wifi",
		     "toradex,verdin-imx8mp",
		     "fsl,imx8mp";
};
